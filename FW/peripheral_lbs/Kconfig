## FW/peripheral_lbs/Kconfig
```kconfig
#
# Copyright (c) 2018 Nordic Semiconductor
#
# SPDX-License-Identifier: LicenseRef-Nordic-5-Clause
#

source "Kconfig.zephyr"

menu "Nordic LED-Button BLE GATT service sample"

config BT_LBS_SECURITY_ENABLED
	bool "Enable security"
	default n

endmenu
```

## FW/peripheral_lbs/build/Kconfig/Kconfig.shield
```kconfig
osource "c:/users/nathan/documents/pocketconcepts/solar_attiny/fw/peripheral_lbs/boards/shields/*/Kconfig.shield"
osource "C:/ncs/v3.0.2/nrf/boards/shields/*/Kconfig.shield"
```
